## sdkconfig.defaults
```kconfig
# ESP32 Play Clock - Default Configuration
# Override flash size to 4MB for actual hardware
CONFIG_ESPTOOLPY_FLASHSIZE_4MB=y
CONFIG_ESPTOOLPY_FLASHSIZE="4MB"

# UART Configuration for CH340C USB-to-Serial
CONFIG_ESPTOOLPY_FLASHMODE_DIO=y
CONFIG_ESPTOOLPY_FLASHFREQ_40M=y

# UART0 (Console) Configuration
CONFIG_UART_ISR_IN_IRAM=y

# Partition table
CONFIG_PARTITION_TABLE_SINGLE_APP=y
CONFIG_PARTITION_TABLE_FILENAME="partitions_singleapp.csv"

# Disable Bluetooth for radio module
CONFIG_BT_ENABLED=n
CONFIG_BT_BLUEDROID_ENABLED=n

# Disable WiFi (not used in play clock)
CONFIG_ESP_WIFI_ENABLED=n

# Optimizations for scoreboard module
CONFIG_FREERTOS_HZ=1000
CONFIG_ESP_DEFAULT_CPU_FREQ_MHZ_240=y

# Flash chip support
CONFIG_SPI_FLASH_SUPPORT_BOYA_CHIP=y
```
